## components/touch/Kconfig.projbuild
```kconfig
menu "Touch Screen Configuration"

choice TOUCH_TYPE
    prompt "Touch controller type"
    default TOUCH_TYPE_NONE
    help
        Select the touch screen controller used with your TFT display.

config TOUCH_TYPE_NONE
    bool "None (disabled)"
config TOUCH_TYPE_XPT2046
    bool "XPT2046 (SPI resistive)"
config TOUCH_TYPE_FT6X06
    bool "FT6x06 (I2C capacitive)"

endchoice

if TOUCH_TYPE_XPT2046

config TOUCH_XPT2046_CS
    int "CS pin"
    default 21
    help
        GPIO for XPT2046 chip select. Shares SPI2 bus with TFT.

config TOUCH_XPT2046_IRQ
    int "IRQ pin (optional, -1 = none)"
    default -1
    help
        GPIO for XPT2046 touch interrupt. Set to -1 to disable.

endif # TOUCH_TYPE_XPT2046

endmenu
```

## sdkconfig.defaults
```kconfig
# ESP32-S3 target
CONFIG_IDF_TARGET_ESP32S3=y
CONFIG_ESP_DEFAULT_CPU_FREQ_MHZ_240=y
CONFIG_FREERTOS_HZ=1000

# UART / JTAG
CONFIG_ESP_CONSOLE_UART=y
CONFIG_ESP_CONSOLE_UART_NUM=0

CONFIG_LOG_DEFAULT_LEVEL_INFO=y
CONFIG_LOG_DEFAULT_LEVEL=3
CONFIG_LOG_MAXIMUM_EQUALS_DEFAULT=y

CONFIG_SPI_MASTER_IN_IRAM=y
CONFIG_ESP_TASK_WDT_TIMEOUT_S=10

# Partycja SPIFFS dla fontów (16MB flash)
CONFIG_PARTITION_TABLE_CUSTOM=y
CONFIG_PARTITION_TABLE_CUSTOM_FILENAME="partitions.csv"
CONFIG_ESPTOOLPY_FLASHSIZE_16MB=y
CONFIG_ESPTOOLPY_FLASHSIZE="16MB"

# PSRAM 8MB (octal)
CONFIG_SPIRAM=y
CONFIG_SPIRAM_MODE_OCT=y
CONFIG_SPIRAM_SPEED_40M=y
CONFIG_SPIRAM_SPEED=40
CONFIG_SPIRAM_USE_MALLOC=y

# Flash
CONFIG_ESPTOOLPY_FLASHMODE_QIO=y
CONFIG_ESPTOOLPY_FLASHFREQ_80M=y
CONFIG_ESPTOOLPY_FLASH_MODE_AUTO_DETECT=y

# TFT - ustawiony tymczasowo ST7735
CONFIG_ST7735=y
CONFIG_WIDTH=160
CONFIG_HEIGHT=128
CONFIG_OFFSETX=1
CONFIG_OFFSETY=2
CONFIG_MOSI_GPIO=11
CONFIG_SCLK_GPIO=12
CONFIG_TFT_CS_GPIO=10
CONFIG_DC_GPIO=14
CONFIG_RESET_GPIO=9
CONFIG_BL_GPIO=19
CONFIG_FRAME_BUFFER=y
CONFIG_XPT2046_DISABLE=y
CONFIG_SPI2_HOST=y
# SD MISO współdzielone z TFT na SPI2
CONFIG_XPT2046_ENABLE_SAME_BUS=y

# ── Touch screen (domyślnie wyłączony) ──────────────────────
# CONFIG_TOUCH_TYPE_NONE=y
# CONFIG_TOUCH_TYPE_XPT2046 is not set
# Aby włączyć XPT2046: idf.py menuconfig → Touch Screen Configuration

# ── Wi-Fi ───────────────────────────────────────────────────
CONFIG_ESP_WIFI_ENABLED=y
CONFIG_ESP_WIFI_SOFTAP_SUPPORT=y
CONFIG_ESP_WIFI_STA_DISCONNECTED_PM_ENABLE=n

# ── Bluetooth (BLE GATT server via NimBLE) ──────────────────
CONFIG_BT_ENABLED=y
CONFIG_BT_NIMBLE_ENABLED=y
CONFIG_BT_NIMBLE_MAX_CONNECTIONS=2
CONFIG_BT_NIMBLE_HOST_TASK_STACK_SIZE=8192
CONFIG_BT_BLUEDROID_ENABLED=n
CONFIG_BT_BLE_ENABLED=y
```
